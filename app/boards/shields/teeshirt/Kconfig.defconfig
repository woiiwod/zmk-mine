## app/boards/shields/teeshirt/Kconfig.defconfig
```kconfig
# Copyright (c) 2020 The ZMK Contributors
# SPDX-License-Identifier: MIT

if SHIELD_TEESHIRT

config ZMK_KEYBOARD_NAME
    default "TeeShirt"
```
